## boards/our_board/board.yml
```yaml
board:
  name: our_board
  full_name: Our Board
  vendor: custom
  socs:
  - name: esp32s3
```

## boards/our_board2/board.yml
```yaml
board:
  name: our_board2
  full_name: Our Board 2
  vendor: custom
  socs:
  - name: esp32s3
```

## modules/our_led_sensor/Kconfig
```kconfig
menu "Our LED Sensor Module"
rsource "drivers/sensor/our_led_sensor/Kconfig"
endmenu
```

## modules/our_led_sensor/drivers/sensor/our_led_sensor/Kconfig
```kconfig
# SPDX-License-Identifier: Apache-2.0

config OUR_LED_SENSOR
	bool "Our LED Sensor driver"
	default y
	depends on DT_HAS_CUSTOM_LED_SENSOR_ENABLED
	select GPIO
	help
	  Enable the custom LED sensor driver.
```

## modules/our_led_sensor/dts/bindings/sensor/custom,led-sensor.yaml
```yaml
description: Custom LED Sensor (GPIO-based)

compatible: "custom,led-sensor"

include: sensor-device.yaml

properties:
  gpios:
    type: phandle-array
    required: true
    description: GPIO connected to the LED
```
